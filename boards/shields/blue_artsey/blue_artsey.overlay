/{
	chosen{
		zmk,kscan = &default_kscan;
		zephyr,console = &cdc_acm_uart;

	};

	default_kscan: kscan{
		compatible = "zmk,kscan-gpio-direct";
		wakeup-source;
		
		label = "KSCAN";
	
		input-gpios = 
			<0 0 &gpio1 6 (GPIO_ACTIVE_LOW | GPIO_PULL_UP)>,
			<1 0 &gpio1 4 (GPIO_ACTIVE_LOW | GPIO_PULL_UP)>,
			<2 0 &gpio0 11 (GPIO_ACTIVE_LOW | GPIO_PULL_UP)>,
			<3 0 &gpio1 0 (GPIO_ACTIVE_LOW | GPIO_PULL_UP)>,
			<4 0 &gpio0 24 (GPIO_ACTIVE_LOW | GPIO_PULL_UP)>,
			<5 0 &gpio0 22 (GPIO_ACTIVE_LOW | GPIO_PULL_UP)>,
			<6 0 &gpio0 20 (GPIO_ACTIVE_LOW | GPIO_PULL_UP)>,
			<7 0 &gpio0 17 (GPIO_ACTIVE_LOW | GPIO_PULL_UP)>;
		};
};