## boards/shields/blue_artsey/Kconfig.defconfig
```kconfig
config ZMK_USB
	default n

config ZMK_BLE
	default y


if SHIELD_BLUE_ARTSEY

config ZMK_KEYBOARD_NAME
	default "blue_artsey"

endif
```

## config/boards/shields/blue_artsey/Kconfig.defconfig
```kconfig
config CONFIG_ZMK_KSCAN_DIRECT_POLLING
	default y

config ZMK_USB
	default y

if SHIELD_BLUE_ARTSEY

config ZMK_KEYBOARD_NAME
	default "blue_artsey"

endif
```
